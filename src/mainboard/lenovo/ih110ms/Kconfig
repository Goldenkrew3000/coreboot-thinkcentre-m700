## src/mainboard/lenovo/ih110ms/Kconfig
```kconfig
# SPDX-License-Identifier: GPL-2.0-only

if BOARD_LENOVO_IH110MS

config BOARD_SPECIFIC_OPTIONS
	def_bool y
	select BOARD_ROMSIZE_KB_8192
	select HAVE_ACPI_RESUME
	select HAVE_ACPI_TABLES
	select HAVE_CMOS_DEFAULT
	select HAVE_OPTION_TABLE
	select INTEL_GMA_HAVE_VBT
	select INTEL_INT15
	select MAINBOARD_HAS_LIBGFXINIT
	select MAINBOARD_HAS_TPM1
	select MEMORY_MAPPED_TPM
	select SKYLAKE_SOC_PCH_H
	select SOC_INTEL_KABYLAKE
	select SUPERIO_ITE_IT8625E

config UART_FOR_CONSOLE
	default 2 if INTEL_LPSS_UART_FOR_CONSOLE
	default 0

config MAINBOARD_DIR
	default "lenovo/ih110ms"

config MAINBOARD_PART_NUMBER
	default "IH110MS"

config PRERAM_CBMEM_CONSOLE_SIZE
	default 0xd00

config DIMM_SPD_SIZE
	default 512 #DDR4

endif
```

## src/mainboard/lenovo/ih110ms/Kconfig.name
```kconfig
# SPDX-License-Identifier: GPL-2.0-only

config BOARD_LENOVO_IH110MS
	bool "IH110MS"
```
